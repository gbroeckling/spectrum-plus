## firmware/sdkconfig.defaults
```kconfig
# ESP32-P4 target
CONFIG_IDF_TARGET="esp32p4"

# CPU
CONFIG_ESP_DEFAULT_CPU_FREQ_MHZ_400=y

# PSRAM (Waveshare P4 module has PSRAM)
CONFIG_SPIRAM=y
CONFIG_SPIRAM_MODE_OCT=y
CONFIG_SPIRAM_SPEED_80M=y

# FreeRTOS
CONFIG_FREERTOS_HZ=1000

# Logging
CONFIG_LOG_DEFAULT_LEVEL_INFO=y

# Partition table
CONFIG_PARTITION_TABLE_CUSTOM=y
CONFIG_PARTITION_TABLE_CUSTOM_FILENAME="partitions.csv"

# Stack overflow detection
CONFIG_FREERTOS_CHECK_STACKOVERFLOW_CANARY=y

# Compiler optimisation
CONFIG_COMPILER_OPTIMIZATION_PERF=y
```
